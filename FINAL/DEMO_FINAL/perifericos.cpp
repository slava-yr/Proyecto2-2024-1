#include "Arduino.h"
#include "perifericos.h"

#include <Wire.h>
#include <Adafruit_GFX.h>
#include <Adafruit_SH110X.h>
#include <Adafruit_NeoPixel.h>

// Para el OLED
#define i2c_Address 0x3c //initialize with the I2C addr 0x3C 
#define SCREEN_WIDTH 128 // OLED display width, in pixels
#define SCREEN_HEIGHT 64 // OLED display height, in pixels
#define OLED_RESET -1   //   QT-PY / XIAO
#define NUMFLAKES 10
#define XPOS 0
#define YPOS 1
#define DELTAY 2
Adafruit_SH1106G display = Adafruit_SH1106G(SCREEN_WIDTH, SCREEN_HEIGHT, &Wire, OLED_RESET);
#define STARTUP_DELAY 500 // Time for the startup screens
#define DISPLAY_DELAY 4000 // Time for each measurement


// Para los leds
#define NUMLEDS 7
#define COLOR_LED 3 // Pin pwm para el color de los leds
#define LEDS_DELAY 100
Adafruit_NeoPixel pixels = Adafruit_NeoPixel(NUMLEDS, COLOR_LED, NEO_GRB + NEO_KHZ800);

// Calentamiento de sensores
#define TIEMPO_CALENTADO 120000 // 2 minutos en ms


const unsigned char pucplogo [] PROGMEM = {
	0xff, 0xff, 0xff, 0xff, 0xff, 0xff, 0xff, 0xff, 0xff, 0xff, 0xff, 0xff, 0xff, 0xff, 0xff, 0xff, 
	0xff, 0xff, 0xff, 0xff, 0xff, 0xff, 0xff, 0xff, 0xff, 0xff, 0xff, 0xff, 0xff, 0xff, 0xff, 0xff, 
	0xff, 0xff, 0xff, 0xff, 0xff, 0xff, 0xff, 0xff, 0xff, 0xff, 0xff, 0xff, 0xff, 0xff, 0xff, 0xff, 
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	0xff, 0xff, 0xff, 0xff, 0xff, 0xff, 0xff, 0xff, 0xff, 0xff, 0xff, 0xff, 0xff, 0xff, 0xff, 0xff
};

const unsigned char subterralogo [] PROGMEM = {
	0xff, 0xff, 0xff, 0xff, 0xff, 0xff, 0xff, 0xff, 0xff, 0xff, 0xff, 0xff, 0xff, 0xff, 0xff, 0xff, 
	0xff, 0xff, 0xff, 0xff, 0xff, 0xff, 0xff, 0xff, 0xff, 0xff, 0xff, 0xff, 0xff, 0xff, 0xff, 0xff, 
	0xff, 0xff, 0xff, 0xff, 0xff, 0xff, 0xff, 0xff, 0xff, 0xff, 0xff, 0xff, 0xff, 0xff, 0xff, 0xff, 
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	0xff, 0xff, 0xff, 0xff, 0xff, 0xff, 0xff, 0xff, 0xff, 0xff, 0xff, 0xff, 0xff, 0xff, 0xff, 0xff
};


/* **********************************************************
 **********CÓDIGO DE CLASE OLED******************************
 ***********************************************************/

OLED::OLED(uint8_t enablePinOLED, uint8_t interruptPin)
{
  _enableOLED = enablePinOLED; // Set the pin for enabling the OLED displays
  _interruptPin = interruptPin; // Pin attached to the button
}

void OLED::begin() // First time 
{
  pinMode(_enableOLED, OUTPUT); // Control pin for OLED
  digitalWrite(_enableOLED, HIGH); // Enable OLED 
  delay(STARTUP_DELAY/2); // wait for the OLED to power up
  display.begin(i2c_Address, true); // Address 0x3C default
  display.clearDisplay();
  display.drawBitmap(0, 0, pucplogo, 128, 64, 1); // Draw pucp logo
  display.display(); // Display it
  delay(STARTUP_DELAY/2); 
  display.clearDisplay();
  display.drawBitmap(0, 0, subterralogo, 128, 64, 1); // Draw subterra logo
  display.display(); // Display it
  delay(STARTUP_DELAY); 
  display.setTextColor(SH110X_WHITE); // Set text color for writing 
  
  display.clearDisplay();
}

void OLED::displayO2(float measurement)
{
  display.setTextSize(2);
  display.setCursor(0, 0);
  display.println(F("% O2\n"));
  display.setTextSize(4); 
  display.print(measurement);
  display.println(F(" %"));
  display.display();
  delay(DISPLAY_DELAY);
  display.clearDisplay();
  display.display();
}

void OLED::displayCO(float measurement)
{
  display.setCursor(0, 0);
  display.setTextSize(2);
  display.println(F("CO (ppm)\n"));
  display.setTextSize(4); 
  display.println(measurement);
  display.display();
  delay(DISPLAY_DELAY);
  display.clearDisplay();
  display.display();
}

void OLED::displayNO2(float measurement)
{
  display.setCursor(0, 0);
  display.setTextSize(2);
  display.println(F("NO2 (ppm)\n"));
  display.setTextSize(4); 
  display.println(measurement);
  display.display();
  delay(DISPLAY_DELAY);
  display.clearDisplay();
  display.display();
}

void OLED::calentandoScreen() // Aprox 9 segundos
{
  for (uint8_t i = 0; i < 1; i++)
  {
    display.clearDisplay();
    display.setCursor(0,0);
    display.setTextSize(2);
    display.println(F("Calentando sensores"));
    for (uint8_t i = 0; i < 10; i++)
    {
      display.print(F("."));
      delay(DISPLAY_DELAY/5);
      display.display();
    }
  } 
}

void OLED::displayLecturas(float measurementCO, float measurementNO2)
{
  display.clearDisplay();
  displayCO(measurementCO);
  displayNO2(measurementNO2);
  // displayO2(measurementO2); 
}

// Muestra los 3 valores pico en una sola pantalla
void OLED::displayPicos(float picoCO, float picoNO2) 
{
  display.setCursor(0, 0);
  display.setTextSize(2);
  display.println(F("Valores pico:"));
  display.print(F("CO: "));
  display.print(picoCO);
  display.println(F(" ppm"));
  display.print(F("NO2: "));
  display.print(picoNO2);
  display.println(F(" ppm"));
  display.display();
  delay(DISPLAY_DELAY);
  display.clearDisplay();
  display.display();
}


char OLED::selectMode() // Selecciona el modo: TWA o STEL
{
  bool buttonState = 0; // Current state of the button
  bool lastButtonState = 1; // previous state of the button
  long unsigned int startPressed = 0;    // the moment the button was pressed
  long unsigned int endPressed = 0;      // the moment the button was released
  unsigned long int holdTime = 0;        // how long the button was hold
  char lastMode = 'T'; // Initialize last mode
  char finalMode; // Return variable

  lastMode = updateDisplay(lastMode);
  while(1) // Loop hasta que el usuario escoja una opción
  {
    buttonState = digitalRead(_interruptPin); // read the button input
    if (buttonState != lastButtonState) { // button state changed
      if (buttonState == LOW)
      {
        startPressed = millis(); // the button has been just pressed
      }  
      else // the button has been just released 
      {
        endPressed = millis();
        holdTime = endPressed - startPressed;
      }
    }
    lastButtonState = buttonState;        // save state for next loop

    if (100 < holdTime && holdTime < 500) // Quick press: Change screen
    {
      lastMode = updateDisplay(lastMode);
      holdTime = 0;
    }

    if (holdTime > 1200) // Confirmar opción
    {
      finalMode = lastMode;
      // Pantalla de modo seleccionado
      display.clearDisplay();
      display.setCursor(0, 0);
      display.setTextSize(5);  

      Serial.println(F("Seleccionó "));
      if (finalMode == 'T')
      {
        display.println(F("TWA"));
      }
      else
      {
        display.println(F("STEL"));
      }
      display.setTextSize(1);
      display.print(F("\nSeleccionado"));
      display.display();
      delay(1000);
      return finalMode;
    }
  }
}

char OLED::updateDisplay(char lastMode)
{
  char newMode;

  display.clearDisplay();
  display.setTextSize(1);
  display.setCursor(0, 0);
  display.println(F("Seleccione el modo de medicion: \n"));
  display.setTextSize(5);  
  
  if (lastMode == 'T') // TWA
  { 
    display.println(F("STEL")); 
    newMode = 'S'; // STEL
  }
  else if (lastMode == 'S')
  {
    display.println(F("TWA")); 
    newMode = 'T'; // TWA
  } 

  display.display();
  delay(600);
  return newMode;
}

/*
void OLED::alarma(uint8_t gas)
{

  if (gas == 0)
  {

  }
  else if (gas == 1)
  {

  }
  else
  {

  }
}
*/
/* **********************************************************
 **********CÓDIGO DE LOS INDICADORES*************************
 ************************************************************/

indicadores::indicadores(uint8_t ledEnablePin, uint8_t vibEnablePin, uint8_t buzzerEnablePin)
{
  _enableLeds = ledEnablePin; 
  _enableVibrador = vibEnablePin;
  _enableBuzzer = buzzerEnablePin;
}

void indicadores::begin()
{
  pinMode(_enableLeds, OUTPUT);
  pinMode(_enableVibrador, OUTPUT);
  pinMode(_enableBuzzer, OUTPUT);
  digitalWrite(_enableBuzzer, HIGH);
  delay(400);
  digitalWrite(_enableBuzzer, LOW);
}

//patrón de luces de inicio del dispositivo
//enciende y apaga atenuando los colores del arreglo colors[]
void indicadores::patron_inicio() {
  digitalWrite(_enableLeds, HIGH);
  uint32_t colors[] = {pixels.Color(0, 0, 255), pixels.Color(0, 255, 0), pixels.Color(255, 0, 0)};
  uint8_t numColors = sizeof(colors) / sizeof(colors[0]);

  for(int j = 0; j < numColors; j++) {
    for(int i = 0; i < NUMLEDS; i++) {
      pixels.setPixelColor(i, colors[j]);
    }
    pixels.show();
    delay(500);
  

    if (j == 0){
      digitalWrite(_enableBuzzer, HIGH);
      digitalWrite(_enableVibrador, HIGH);
      delay(500);
    }
    
    delay(300);
    digitalWrite(_enableBuzzer, LOW);
    digitalWrite(_enableVibrador, LOW);
  }

  for(int i = 0; i < NUMLEDS; i++) {
    pixels.setPixelColor(i,pixels.Color(0,0,0));
  }
  pixels.show();

}

void indicadores::alarma() {
  for (uint8_t j = 0; j < 10; j++) // Repite 10 veces
  {
    for(uint8_t i = 0; i < NUMLEDS; i++) {
      pixels.setPixelColor(i, pixels.Color(255,0,0));
    }
    pixels.show();
    digitalWrite(_enableBuzzer, HIGH);
    digitalWrite(_enableVibrador, HIGH);
    delay(400);
    for(uint8_t i = 0; i < NUMLEDS; i++) {
      pixels.setPixelColor(i,pixels.Color(0,0,0));
    }
    pixels.show();
    digitalWrite(_enableBuzzer, LOW);
    digitalWrite(_enableVibrador, LOW);
    delay(400);
  }
}