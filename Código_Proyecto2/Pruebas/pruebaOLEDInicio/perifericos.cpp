#include "Arduino.h"
#include "perifericos.h"

#include <Wire.h>
#include <Adafruit_GFX.h>
#include <Adafruit_SH110X.h>
#include <Adafruit_NeoPixel.h>

// Para el OLED
#define i2c_Address 0x3c //initialize with the I2C addr 0x3C 
#define SCREEN_WIDTH 128 // OLED display width, in pixels
#define SCREEN_HEIGHT 64 // OLED display height, in pixels
#define OLED_RESET -1   //   QT-PY / XIAO
#define NUMFLAKES 10
#define XPOS 0
#define YPOS 1
#define DELTAY 2
Adafruit_SH1106G display = Adafruit_SH1106G(SCREEN_WIDTH, SCREEN_HEIGHT, &Wire, OLED_RESET);
#define STARTUP_DELAY 500 // Time for the startup screens
#define DISPLAY_DELAY 5000 // Time for each measurement


// Para los leds
#define NUMLEDS 8
#define LEDS_PIN 3 // Pin pwm para el color de los leds
#define LEDS_DELAY 100
Adafruit_NeoPixel pixels = Adafruit_NeoPixel(NUMLEDS, LEDS_PIN, NEO_GRB + NEO_KHZ800);

const unsigned char pucplogo [] PROGMEM = {
	0xff, 0xff, 0xff, 0xff, 0xff, 0xff, 0xff, 0xff, 0xff, 0xff, 0xff, 0xff, 0xff, 0xff, 0xff, 0xff, 
	0xff, 0xff, 0xff, 0xff, 0xff, 0xff, 0xff, 0xff, 0xff, 0xff, 0xff, 0xff, 0xff, 0xff, 0xff, 0xff, 
	0xff, 0xff, 0xff, 0xff, 0xff, 0xff, 0xff, 0xff, 0xff, 0xff, 0xff, 0xff, 0xff, 0xff, 0xff, 0xff, 
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	0xff, 0xff, 0xff, 0xff, 0xff, 0xff, 0xff, 0xff, 0xff, 0xff, 0xff, 0xff, 0xff, 0xff, 0xff, 0xff
};

const unsigned char subterralogo [] PROGMEM = {
	0xff, 0xff, 0xff, 0xff, 0xff, 0xff, 0xff, 0xff, 0xff, 0xff, 0xff, 0xff, 0xff, 0xff, 0xff, 0xff, 
	0xff, 0xff, 0xff, 0xff, 0xff, 0xff, 0xff, 0xff, 0xff, 0xff, 0xff, 0xff, 0xff, 0xff, 0xff, 0xff, 
	0xff, 0xff, 0xff, 0xff, 0xff, 0xff, 0xff, 0xff, 0xff, 0xff, 0xff, 0xff, 0xff, 0xff, 0xff, 0xff, 
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	0xff, 0xff, 0xff, 0xff, 0xff, 0xff, 0xff, 0xff, 0xff, 0xff, 0xff, 0xff, 0xff, 0xff, 0xff, 0xff
};

const unsigned char lowBatteryIcon [] PROGMEM = {
	0xff, 0xff, 0xff, 0xff, 0xff, 0xff, 0xff, 0xff, 0xff, 0xff, 0xff, 0xff, 0xff, 0xff, 0xff, 0xff, 
	0xff, 0xff, 0xff, 0xff, 0xff, 0xff, 0xff, 0xff, 0xff, 0xff, 0xff, 0xff, 0xff, 0xff, 0xff, 0xff, 
	0xff, 0xff, 0xff, 0xff, 0xff, 0xff, 0xff, 0xff, 0xff, 0xff, 0xff, 0xff, 0xff, 0xff, 0xff, 0xff, 
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	0xff, 0xff, 0xff, 0xff, 0xff, 0xff, 0xff, 0xff, 0xff, 0xff, 0xff, 0xff, 0xff, 0xff, 0xff, 0xff
};


/* **********************************************************
 **********CÓDIGO DE CLASE OLED******************************
 ***********************************************************/

OLED::OLED(uint8_t enablePinOLED, uint8_t interruptPin)
{
  _enableOLED = enablePinOLED; // Set the pin for enabling the OLED displays
  _interruptPin = interruptPin; // Pin attached to the button
}

void OLED::begin() // First time 
// Se apaga después del begin. Debes llamar el wakeup y luego lo que quieras hacer.
{
  pinMode(_enableOLED, OUTPUT); // Control pin for OLED
  pinMode(_interruptPin, INPUT);
  // attachInterrupt(digitalPinToInterrupt(_interruptPin), handleButtonPress, RISING); // Interrupt
  digitalWrite(_enableOLED, HIGH); // Enable OLED 
  delay(STARTUP_DELAY/2); // wait for the OLED to power up
  display.begin(i2c_Address, true); // Address 0x3C default
  display.clearDisplay();
  display.drawBitmap(0, 0, pucplogo, 128, 64, 1); // Draw pucp logo
  display.display(); // Display it
  delay(STARTUP_DELAY/2); 
  display.clearDisplay();
  display.drawBitmap(0, 0, subterralogo, 128, 64, 1); // Draw subterra logo
  display.display(); // Display it
  delay(STARTUP_DELAY); 
  display.clearDisplay(); // Clear display
  display.setTextColor(SH110X_WHITE); // Set text color for writing 
  // TODO: Temporizar el calentando screen para que sea el tiempo deseado
  // calentandoScreen(); // Screen de calentando sensores
  digitalWrite(_enableOLED, LOW); // Apaga la pantalla
}

void OLED::wakeUp() // Inicializa tras estar apagado
{
  digitalWrite(_enableOLED, HIGH);
  delay(STARTUP_DELAY/2); // wait for the OLED to power up
  display.begin(i2c_Address, true); // Address 0x3C default
  display.clearDisplay(); 
  display.setTextColor(SH110X_WHITE);
}

void OLED::displayO2(float measurement)
{
  display.setTextSize(2);
  display.setCursor(0, 0);
  display.println("% O2\n");
  display.setTextSize(4); 
  display.print(measurement);
  display.println(" %");
  display.display();
  delay(DISPLAY_DELAY);
  display.clearDisplay();
  display.display();
}

void OLED::displayCO(float measurement)
{
  display.setCursor(0, 0);
  display.setTextSize(2);
  display.println("CO (ppm)\n");
  display.setTextSize(4); 
  display.println(measurement);
  display.display();
  delay(DISPLAY_DELAY);
  display.clearDisplay();
  display.display();
}

void OLED::displayNO2(float measurement)
{
  display.setCursor(0, 0);
  display.setTextSize(2);
  display.println("NO2 (ppm)\n");
  display.setTextSize(4); 
  display.println(measurement);
  display.display();
  delay(DISPLAY_DELAY);
  display.clearDisplay();
  display.display();
}

void OLED::calentandoScreen()
{
  display.setCursor(0,0);
  display.setTextSize(2);
  display.println("Calentando sensores");
  for (int i = 0; i < 10; i++)
  {
    display.print(".");
    delay(DISPLAY_DELAY/5);
    display.display();
  }
  delay(DISPLAY_DELAY/2);
  display.clearDisplay();  
  display.display();
}

void OLED::displayLecturas(float measurementO2, float measurementCO, float measurementNO2)
{
  displayO2(measurementO2);
  displayCO(measurementCO);
  displayNO2(measurementNO2);
  digitalWrite(_enableOLED, LOW); // Apaga la pantalla tras mostrar las lecturas 
}

void OLED::lowBattery() // Pantalla de batería baja
{
  display.drawBitmap(0, 0, lowBatteryIcon, 128, 64, 1);
  display.display();
  delay(STARTUP_DELAY); 
  display.clearDisplay();
  display.display();
  delay(STARTUP_DELAY); 
}

char OLED::selectMode() // Selecciona el modo: TWA o STEL
{
  int buttonState = 0; // Current state of the button
  int lastButtonState = 1; // previous state of the button
  int startPressed = 0;    // the moment the button was pressed
  int endPressed = 0;      // the moment the button was released
  unsigned long int holdTime = 0;        // how long the button was hold
  char lastMode = 'T'; // Initialize last mode
  char finalMode;

  lastMode = updateDisplay(lastMode);
  while(1) // Loop hasta que el usuario escoja una opción
  {
    buttonState = digitalRead(INT0); // read the button input
    if (buttonState != lastButtonState) { // button state changed
      if (buttonState == LOW) startPressed = millis(); // the button has been just pressed 
      else {// the button has been just released
        endPressed = millis();
        holdTime = endPressed - startPressed;
      }
    }
    lastButtonState = buttonState;        // save state for next loop

    if (100 < holdTime && holdTime < 500) // Quick press: Change screen
    {
      lastMode = updateDisplay(lastMode);
      holdTime = 0;
    }

    if (holdTime > 1200)
    {
      finalMode = lastMode;
      Serial.println("Seleccionó ");
      if (finalMode == 'T')
      {
        Serial.println("TWA");
      }
      else
      {
        Serial.println("STEL");
      }
      return; // Pasar al programa principal
    }
  }
}

char OLED::updateDisplay(char lastMode)
{
  char newMode;

  display.clearDisplay();
  display.setTextSize(1);
  display.setCursor(0, 0);
  display.println("Seleccione: \n\n");
  display.setTextSize(5);  
  
  if (lastMode == 'T') // TWA
  { 
    Serial.println("STEL");
    display.println("STEL"); 
    newMode = 'S'; // STEL
  }
  else if (lastMode == 'S')
  {
    Serial.println("TWA");
    display.println("TWA"); 
    newMode = 'T'; // TWA
  } 

  display.display();
  return newMode;
}

/* **********************************************************
 **********CÓDIGO DE LOS INDICADORES*************************
 ************************************************************/

indicadores::indicadores(uint8_t ledEnablePin, uint8_t vibEnablePin, uint8_t buzzerEnablePin)
{
  _enableLeds = ledEnablePin; 
  _enableVibrador = vibEnablePin;
  _enableBuzzer = buzzerEnablePin;
}

void indicadores::begin()
{
  pinMode(_enableLeds, OUTPUT);
  pinMode(_enableVibrador, OUTPUT);
  pinMode(_enableBuzzer, OUTPUT);
}

  //controla la intensidad de cada color ingresado(0-100%)y devuelve el comando pixels con la intensidad adecuada
uint32_t indicadores::color_intensity(uint32_t color, uint8_t scale) {
  uint8_t r = (color >> 16) & 0xFF;
  uint8_t g = (color >> 8) & 0xFF;
  uint8_t b = color & 0xFF;
  r = (r * scale) / 100;
  g = (g * scale) / 100;
  b = (b * scale) / 100;
  return pixels.Color(r, g, b);
}

//patrón de luces de inicio del dispositivo
//enciende y apaga atenuando los colores del arreglo colors[]
void indicadores::patron_inicio() {
  uint32_t colors[] = {pixels.Color(0, 0, 255), pixels.Color(0, 255, 0), pixels.Color(255, 0, 0)};
  int numColors = sizeof(colors) / sizeof(colors[0]);

  for(int j = 0; j < numColors; j++) {
    for(int brightness = 0; brightness <= 100; brightness++) {
      for(int i = 0; i < NUMLEDS; i++) {
        pixels.setPixelColor(i, color_intensity(colors[j], brightness));
      }
      digitalWrite(_enableVibrador, HIGH);
      pixels.show();
      delay(8);
    }

    delay(300);

    for(int brightness = 100; brightness >= 0; brightness--) {
      for(int i = 0; i < NUMLEDS; i++) {
        pixels.setPixelColor(i, color_intensity(colors[j], brightness));
      }
      digitalWrite(_enableVibrador, LOW);
      pixels.show();
      delay(8);
    }
  }

  for(int brightness = 100; brightness >= 0; brightness--) {
    for(int i = 0; i < NUMLEDS; i++) {
      pixels.setPixelColor(i, pixels.Color(brightness*255/100, brightness*255/100, brightness*255/100));
    }
    digitalWrite(_enableBuzzer, HIGH);
    pixels.show();
    delay(8);
  }
  digitalWrite(_enableBuzzer, LOW);
  delay(500);
}

void indicadores::lectura_alta() {
  for (int i = 0; i < 10; i++) {
    for(int i = 0; i < NUMLEDS; i++) {
      pixels.setPixelColor(i, color_intensity(pixels.Color(255, 0, 0), 90));
    }
    pixels.show();
    digitalWrite(_enableVibrador, HIGH);
    digitalWrite(_enableBuzzer, HIGH);
    delay(200);

    for(int i = 0; i < NUMLEDS; i++) {
      pixels.setPixelColor(i, color_intensity(pixels.Color(0, 0, 255), 90));
    }
    pixels.show();
    digitalWrite(_enableVibrador, LOW);
    digitalWrite(_enableBuzzer, LOW);
    delay(200);
  }
  for(int i = 0; i < NUMLEDS; i++) {
      pixels.setPixelColor(i, pixels.Color(0, 0, 0));
  }
  delay(200);
}

void indicadores::lectura_moderada() {
  for (int i = 0; i < 10; i++) {
    for(int i = 0; i < NUMLEDS; i++) {
      pixels.setPixelColor(i, color_intensity(pixels.Color(255, 191, 0), 90));
    }
    pixels.show();
    digitalWrite(_enableVibrador, HIGH);
    digitalWrite(_enableBuzzer, HIGH);
    delay(300);

    for(int i = 0; i < NUMLEDS; i++) {
      pixels.setPixelColor(i, color_intensity(pixels.Color(0, 0, 0), 90));
    }
    pixels.show();
    digitalWrite(_enableVibrador, LOW);
    digitalWrite(_enableBuzzer, LOW);
    delay(300);
  }
  for(int i = 0; i < NUMLEDS; i++) {
      pixels.setPixelColor(i, pixels.Color(0, 0, 0));
  }
  delay(300);
}

void indicadores::lectura_normal() {
  for (int i = 0; i < 3; i++) {
    for(int i = 0; i < NUMLEDS; i++) {
      pixels.setPixelColor(i, color_intensity(pixels.Color(0, 255, 0), 90));
    }
    pixels.show();
    digitalWrite(_enableVibrador, HIGH);
    digitalWrite(_enableBuzzer, HIGH);
    delay(500);

    for(int i = 0; i < NUMLEDS; i++) {
      pixels.setPixelColor(i, color_intensity(pixels.Color(0, 0, 0), 90));
    }
    pixels.show();
    digitalWrite(_enableVibrador, LOW);
    digitalWrite(_enableBuzzer, LOW);
    delay(500);
  }
  for(int i = 0; i < NUMLEDS; i++) {
      pixels.setPixelColor(i, pixels.Color(0, 0, 0));
  }
  delay(500);
}

/* **********************************************************
 **********CÓDIGO DEL BOTÓN******************************
 ***********************************************************/

// TODO:
// * hacer la función de interrupción
// 

